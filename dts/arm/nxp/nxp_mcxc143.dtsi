/*
 * Copyright 2024 NXP
 *
 * SPDX-License-Identifier: Apache-2.0
 */

#include <nxp/nxp_mcxc_common.dtsi>

&sram0 {
	reg = <0x20000000 DT_SIZE_K(32)>;
};

&flash0 {
	reg = <0 DT_SIZE_K(128)>;
};

&usb {
	no-voltage-regulator;
};